## conf/layer.conf
```bitbake
# We have a conf and classes directory, add to BBPATH
BBPATH .= ":${LAYERDIR}"

# We have recipes-* directories, add to BBFILES
BBFILES += "${LAYERDIR}/recipes-*/*/*.bb \
	${LAYERDIR}/recipes-*/*/*.bbappend"

BBFILE_COLLECTIONS += "baylibre-agl-blsched"
BBFILE_PATTERN_baylibre-agl-blsched = "^${LAYERDIR}/"
BBFILE_PRIORITY_baylibre-agl-blsched = "6"

LAYERDEPENDS_baylibre-agl-blsched = "rcar-gen3"
```
